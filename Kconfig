## Kconfig
```kconfig
#
# Copyright (C) 2023 Xiaomi Corporation
#
# Licensed under the Apache License, Version 2.0 (the "License");
# you may not use this file except in compliance with the License.
# You may obtain a copy of the License at
#
#      http://www.apache.org/licenses/LICENSE-2.0
#
# Unless required by applicable law or agreed to in writing, software
# distributed under the License is distributed on an "AS IS" BASIS,
# WITHOUT WARRANTIES OR CONDITIONS OF ANY KIND, either express or implied.
# See the License for the specific language governing permissions and
# limitations under the License.
#

config ANDROID_KEYSTORE
	tristate "KeyStore framework"
	depends on ANDROID_BINDER
	select ANDROID_HARDWARE_INTERFACES
	select ANDROID_LIBHIDL
	select ANDROID_KEYMASTER
	default n
	---help---
		Keystore, the codebase come from AOSP

config ANDROID_KEYSTORE_STACKSIZE
	int "keystore stack size"
	depends on ANDROID_KEYSTORE
	default 8192

config ANDROID_KEYSTORE_THREAD_STACKSIZE
	int "keystore son thread stack size"
	depends on ANDROID_KEYSTORE
	default ANDROID_KEYSTORE_STACKSIZE

config ANDROID_KEYSTORE_TOOL
	tristate "Keystore client command line tool"
	depends on ANDROID_KEYSTORE
	select LIB_CHROMIUM
	default n
	---help---
		Keystore client command line tool

config ANDROID_KEYSTORE_TEST
	tristate "KeyStore Test Case"
	depends on ANDROID_KEYSTORE
	depends on LIB_GOOGLETEST
	default n
```
